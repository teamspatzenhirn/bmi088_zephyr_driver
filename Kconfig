## drivers/sensor/bosch/bmi088/Kconfig
```kconfig
# Bosch BMI088 inertial measurement configuration options

# SPDX-License-Identifier: Apache-2.0

menuconfig BMI088
	bool "Bosch BMI088 inertial measurement unit"
	default y
	depends on DT_HAS_BOSCH_BMI088_ACC_ENABLED && DT_HAS_BOSCH_BMI088_GYR_ENABLED
	select SPI
	help
	  Enable Bosch BMI088 inertial measurement unit that provides acceleration
	  and angular rate measurements.
```
